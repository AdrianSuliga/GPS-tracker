## CMakeLists.txt
```
cmake_minimum_required(VERSION 3.20.0)

find_package(Zephyr REQUIRED HINTS $ENV{ZEPHYR_BASE})
project(GPS-tracker)

target_sources(app PRIVATE src/main.c)
```

## Kconfig
```
menu "GPS tracker" 

config COAP_DEVICE_NAME
    string "Device resource name - this will be the device name on the CoAP server"
    default "cali.test.nrf91"

config COAP_SERVER_PSK
    string "Server PSK"
    default "2e666f726e69756d"

config COAP_SERVER_HOSTNAME
    string "CoAP server hostname"

config COAP_SERVER_PORT
    int "CoAP server port"
    default 5683

config COAP_GNSS_RESOURCE
    string "CoAP resource - GNSS channel for GPS tracker"
    default "large-update"

config COAP_GEO_RESOURCE
    string "CoAP resource - GEO data for GPS tracker"
    default "validate"

config GNSS_PERIODIC_INTERVAL
    int "Fix interval for periodic GNSS fixes"
    range 10 65535
    default 30
    help
        Fix interval (in seconds) for periodic fixes

config GNSS_PERIODIC_TIMEOUT
    int "Fix timeout for periodic GNSS fixes"
    range 0 65535
    default 480
    help
      Fix timeout (in seconds) for periodic fixes

endmenu

menu "Zephyr Kernel"

source "Kconfig.zephyr"

endmenu
```

## prj.conf
```kconfig
# Logging
CONFIG_LOG=y

# Floats
CONFIG_FPU=y

# Buttons and LED library
CONFIG_DK_LIBRARY=y

# Network
CONFIG_NETWORKING=y
CONFIG_NET_NATIVE=n
CONFIG_NET_SOCKETS=y
CONFIG_NET_SOCKETS_OFFLOAD=y
CONFIG_POSIX_API=y

# Memory
CONFIG_HEAP_MEM_POOL_SIZE=4096
CONFIG_MAIN_STACK_SIZE=4096

# Modem library
CONFIG_NRF_MODEM_LIB=y
CONFIG_MODEM_KEY_MGMT=y

# LTE Link Control
CONFIG_LTE_LINK_CONTROL=y
CONFIG_LTE_NETWORK_MODE_LTE_M_NBIOT_GPS=y
CONFIG_LTE_LC_EDRX_MODULE=y
CONFIG_LTE_LC_PSM_MODULE=y
CONFIG_LTE_LC_NEIGHBOR_CELL_MEAS_MODULE=y

# CoAP protocol
CONFIG_COAP=y
CONFIG_COAP_SERVER_HOSTNAME="californium.eclipseprojects.io"
CONFIG_COAP_SERVER_PORT=5684
```

## src/main.c
```c
#include "lte_common.h"
#include "gnss_common.h"
#include "coap_common.h"

#include <zephyr/logging/log.h>
#include <dk_buttons_and_leds.h>

LOG_MODULE_REGISTER(Tracker_Main, LOG_LEVEL_DBG);

static void reset_all_leds()
{
    dk_set_leds_state(DK_NO_LEDS_MSK, DK_ALL_LEDS_MSK);
}

int main()
{
    int err;

    err = dk_leds_init();
    if (err != 0) {
        LOG_ERR("Failed to initialize the DK library, error %d", err);
        return err;
    }

    err = modem_configure();
    if (err) {
        LOG_ERR("Failed to configure modem");
        return err;
    }

    err = gnss_init_and_start();
    if (err) {
        LOG_ERR("GNSS could not start, error %d", err);
        return err;
    }

    LOG_INF("GNSS setup complete");

    struct lte_lc_ncellmeas_params params = {
        .search_type = LTE_LC_NEIGHBOR_SEARCH_TYPE_GCI_EXTENDED_COMPLETE,
        .gci_count = MAX_GCI_CELLS
    };

    while (true) {
        // Wait for GPS data
        LOG_INF("Waiting for GPS data");
        err = k_sem_take(&gps_fix_found, K_SECONDS(60));

        // Establish LTE connection to send data
        LOG_INF("Waiting for LTE connection");
        err = lte_lc_func_mode_set(LTE_LC_FUNC_MODE_NORMAL);
        if (err) {
            LOG_ERR("Failed to establish LTE connection");
            lte_lc_func_mode_set(LTE_LC_FUNC_MODE_DEACTIVATE_LTE);
            reset_all_leds();
            continue;
        }

        k_sem_take(&lte_connected, K_FOREVER);
        LOG_INF("LTE connection established");
        dk_set_led_on(DK_LED1);

        // Setup CoAP
        err = coap_init();
        if (err) {
            LOG_ERR("Failed to setup CoAP connection");
            lte_lc_func_mode_set(LTE_LC_FUNC_MODE_DEACTIVATE_LTE);
            reset_all_leds();
            continue;
        }
        dk_set_led_on(DK_LED2);

        // Send GPS data to CoAP server
        err = coap_put_gnss(&gps_data);
        if (err) {
            LOG_ERR("Failed to send CoAP data");
        } else {
            LOG_INF("New GPS data sent");
        }

        // Request neighbor cell measurement
        err = lte_lc_neighbor_cell_measurement(&params);
        if (err < 0) {
            LOG_ERR("Neighbor cell measurement failed, error %d", err);
            lte_lc_func_mode_set(LTE_LC_FUNC_MODE_DEACTIVATE_LTE);
            reset_all_leds();
            continue;
        }

        // Wait for neighbor cell measurement results
        LOG_INF("Waiting for cell measurement data");
        k_sem_take(&neighbors_found, K_FOREVER);
        dk_set_led_on(DK_LED3);

        // Send neighbor cell data to CoAP server
        err = coap_put_lte(&geo_data);
        if (err) {
            LOG_ERR("Failed to send CoAP data");
        } else {
            LOG_INF("New cell measurement data sent");
        }

        // Break LTE connection so GPS has time for getting fix
        err = lte_lc_func_mode_set(LTE_LC_FUNC_MODE_DEACTIVATE_LTE);
        reset_all_leds();
        if (err) {
            LOG_ERR("Failed to deactivate LTE");
            continue;
        }
    }

    return 0;
}
```

## inc/coap_common.h
```c
#ifndef COAP_COMMON_H
#define COAP_COMMON_H

#include <stdio.h>
#include "gnss_common.h"
#include "lte_common.h"

#define COAP_VERSION 1
#define COAP_MAX_MSG_LEN 1024

#define SEC_TAG 12

int coap_init();

int coap_put_gnss(struct gnss_data *data);

int coap_put_lte(struct lte_geo_data *data);

#endif /* COAP_COMMON_H */
```

## inc/gnss_common.h
```c
#ifndef GNSS_COMMON_H
#define GNSS_COMMON_H

#include <zephyr/kernel.h>

extern struct k_sem gps_fix_found;

struct fix_time {
    uint16_t year;
    uint8_t month;
    uint8_t day;
    uint8_t hour;
    uint8_t minute;
    uint8_t second;
};

struct gnss_data {
    double longitude;
    double latitude;
    double altitude;
    struct fix_time time;
};

extern struct gnss_data gps_data;

// Initialize and start GNSS
int gnss_init_and_start();

#endif /* GNSS_COMMON_H */
```

## inc/lte_common.h
```c
#ifndef LTE_COMMON_H
#define LTE_COMMON_H

#include <zephyr/kernel.h>
#include <modem/lte_lc.h>

#define MAX_NCELLS 10
#define MAX_GCI_CELLS 15

extern struct k_sem lte_connected;
extern struct k_sem neighbors_found;

struct cell_data {
    int mcc;
    int mnc;
    uint32_t id;
    uint32_t tac;
    int16_t rsrp;
};

struct ncell_data {
    uint32_t earfcn;
    uint16_t pci;
    int16_t rsrp;
};

struct lte_geo_data {
    struct cell_data current_cell;
    
    uint8_t ncells_count;
    struct ncell_data ncells[MAX_NCELLS];

    uint8_t gci_cells_count;
    struct cell_data gci_cells[MAX_GCI_CELLS];
};

extern struct lte_geo_data geo_data;

// Handler for LTE events
void lte_handler(const struct lte_lc_evt *const evt);

// Modem initialization and LTE connection
int modem_configure();

#endif /* LTE_COMMON_H */
```

## src/coap_common.c
```c
#include "coap_common.h"
#include "gnss_common.h"

#include <zephyr/net/socket.h>
#include <zephyr/net/coap.h>
#include <zephyr/logging/log.h>
#include <zephyr/random/random.h>
#include <zephyr/net/tls_credentials.h>
#include <modem/modem_key_mgmt.h>

LOG_MODULE_REGISTER(Tracker_CoAP, LOG_LEVEL_INF);

static struct sockaddr_storage server;
static uint8_t coap_buffer[COAP_MAX_MSG_LEN];
static uint16_t next_token;
static int sock;

static int server_resolve()
{
    int err;

    struct addrinfo *result;
    struct addrinfo hints = {
        .ai_family = AF_INET,
        .ai_socktype = SOCK_DGRAM
    };
    char ipv4_addr[NET_IPV4_ADDR_LEN];

    err = getaddrinfo(CONFIG_COAP_SERVER_HOSTNAME, NULL, &hints, &result);
    if (err != 0) {
        LOG_ERR("getaddrinfo failed, error %d", err);
        return -EIO;
    }

    if (result == NULL) {
        LOG_ERR("Address for %s not found", CONFIG_COAP_SERVER_HOSTNAME);
        return -ENOENT;
    }

    struct sockaddr_in *server4 = ((struct sockaddr_in*)&server);

    server4->sin_addr.s_addr = ((struct sockaddr_in*)result->ai_addr)->sin_addr.s_addr;
    server4->sin_family = AF_INET;
    server4->sin_port = htons(CONFIG_COAP_SERVER_PORT);

    inet_ntop(AF_INET, &server4->sin_addr.s_addr, ipv4_addr, sizeof(ipv4_addr));

    freeaddrinfo(result);

    return 0;
}

static int client_init()
{
    int err;

    sock = socket(AF_INET, SOCK_DGRAM, IPPROTO_DTLS_1_2);
    if (sock < 0) {
        LOG_ERR("Failed to create CoAP socket, error %d", sock);
        return sock;
    }

    enum {
        NONE = 0,
        OPTIONAL = 1,
        REQUIRED = 2
    };

    int verify = REQUIRED;

    err = setsockopt(sock, SOL_TLS, TLS_PEER_VERIFY, &verify, sizeof(verify));
    if (err) {
	    LOG_ERR("Failed to setup peer verification, errno %d\n", errno);
	    return -errno;
    }

    err = setsockopt(sock, SOL_TLS, TLS_HOSTNAME, CONFIG_COAP_SERVER_HOSTNAME, strlen(CONFIG_COAP_SERVER_HOSTNAME));
    if (err) {
        LOG_ERR("Failed to setup TLS hostname (%s), errno %d\n", CONFIG_COAP_SERVER_HOSTNAME, errno);
	    return -errno;
    }

    sec_tag_t sec_tag_list[] = { SEC_TAG };
    err = setsockopt(sock, SOL_TLS, TLS_SEC_TAG_LIST, sec_tag_list, sizeof(sec_tag_t) * ARRAY_SIZE(sec_tag_list));
    if (err) {
        LOG_ERR("Failed to setup socket security tag, errno %d\n", errno);
	    return -errno;
    }

    err = connect(sock, (const struct sockaddr*)&server, sizeof(struct sockaddr_in));
    if (err < 0) {
        LOG_ERR("Failed to connect to CoAP socket, error %d", err);
        return err;
    }

    next_token = sys_rand32_get();

    return 0;
}

static int coap_put(char *data, uint16_t size, char *resource)
{
    int err;
    struct coap_packet coap_request;

    next_token = sys_rand32_get();

    err = coap_packet_init(&coap_request, coap_buffer, sizeof(coap_buffer),
                        COAP_VERSION, COAP_TYPE_NON_CON, sizeof(next_token),
                        (uint8_t*)&next_token, COAP_METHOD_PUT, coap_next_id());
    if (err < 0) {
        LOG_ERR("Failed to create CoAP PUT request, error %d", err);
        return err;
    }
    
    err = coap_packet_append_option(&coap_request, COAP_OPTION_URI_PATH,
                                    (uint8_t*)resource,
                                    strlen(resource));
    if (err < 0) {
        LOG_ERR("Failed to append CoAP option, error %d", err);
        return err;
    }

    const uint8_t text = COAP_CONTENT_FORMAT_APP_JSON;
    err = coap_packet_append_option(&coap_request, COAP_OPTION_CONTENT_FORMAT,
                                    &text, sizeof(text));
    if (err < 0) {
        LOG_ERR("Failed to append CoAP option, error %d", err);
        return err;
    }

    err = coap_packet_append_payload_marker(&coap_request);
    if (err < 0) {
        LOG_ERR("Failed to append CoAP payload marker, error %d", err);
        return err;
    }

    err = coap_packet_append_payload(&coap_request, (uint8_t*)data, size);
    if (err < 0) {
        LOG_ERR("Failed to append payload to CoAP packet, error %d", err);
        return err;
    }

    err = send(sock, coap_request.data, coap_request.offset, 0);
    if (err < 0) {
        LOG_ERR("Failed to send CoAP request, error %d", err);
        return err;
    }

    LOG_INF("CoAP PUT request sent");

    return 0;
}

int coap_init()
{
    int err;

    err = server_resolve();
    if (err != 0) {
        return err;
    }

    err = client_init();
    if (err != 0) {
        return err;
    }

    return 0;
}

int coap_put_gnss(struct gnss_data *data)
{
    char msg[256];
    uint16_t n = snprintf(msg, sizeof(msg), "{gnss: {long:%.6f,lat:%.6f,alt:%.2f,time:%u-%u-%u %u:%u:%u}}",
                            data->longitude, data->latitude, data->altitude,
                            data->time.year, data->time.month, data->time.day,
                            data->time.hour, data->time.minute, data->time.second);

    return coap_put(msg, n, CONFIG_COAP_GNSS_RESOURCE);
}

int coap_put_lte(struct lte_geo_data *data)
{
    char msg[512];
    int offset = 0;

    offset += snprintf(msg + offset, sizeof(msg) - offset,
        "{geo: {"
        "current_cell: {"
            "mcc:%d,"
            "mnc:%d,"
            "id:%u,"
            "tac:%u,"
            "rsrp:%d"
        "},",
        data->current_cell.mcc,
        data->current_cell.mnc,
        data->current_cell.id,
        data->current_cell.tac,
        data->current_cell.rsrp
    );

    offset += snprintf(msg + offset, sizeof(msg) - offset,
        " gci_cells: ["
    );

    for (int i = 0; i < data->gci_cells_count; i++) {
        offset += snprintf(msg + offset, sizeof(msg) - offset,
            "{"
                "mcc:%d,"
                "mnc:%d,"
                "id:%u,"
                "tac:%u,"
                "rsrp:%d"
            "}%s",
            data->gci_cells[i].mcc,
            data->gci_cells[i].mnc,
            data->gci_cells[i].id,
            data->gci_cells[i].tac,
            data->gci_cells[i].rsrp,
            (i < data->gci_cells_count - 1) ? "," : ""
        );
    }

    offset += snprintf(msg + offset, sizeof(msg) - offset, "]"
        "}}"
    );

    return coap_put(msg, offset, CONFIG_COAP_GEO_RESOURCE);
}
```

## src/gnss_common.c
```c
#include "gnss_common.h"

#include <stdio.h>
#include <modem/lte_lc.h>
#include <nrf_modem_gnss.h>
#include <zephyr/logging/log.h>

LOG_MODULE_REGISTER(Tracker_GNSS, LOG_LEVEL_INF);

K_SEM_DEFINE(gps_fix_found, 0, 1);

struct gnss_data gps_data = {
    .longitude = 0.0f,
    .latitude = 0.0f,
    .altitude = 0.0f,
    .time = { .year = 1, .month = 1, .day = 1,
              .hour = 0, .minute = 0, .second = 0 }
};

static struct nrf_modem_gnss_pvt_data_frame pvt_data;

static void gnss_event_handler(int event)
{
    int err, num_satelites;

    switch (event) {
        case NRF_MODEM_GNSS_EVT_PVT:
            num_satelites = 0;
            for (int i = 0; i < 12; ++i) {
                if (pvt_data.sv[i].signal != 0) {
                    ++num_satelites;
                }
            }

            LOG_INF("Searching. Current satelites: %d", num_satelites);
            err = nrf_modem_gnss_read(&pvt_data, sizeof(pvt_data), NRF_MODEM_GNSS_DATA_PVT);
            if (err) {
                LOG_ERR("Failed to read nRF GNSS, error %d", err);
                return;
            }

            if (pvt_data.flags & NRF_MODEM_GNSS_PVT_FLAG_FIX_VALID) {
                LOG_INF("GNSS got fix");

                gps_data.longitude = pvt_data.longitude;
                gps_data.latitude = pvt_data.latitude;
                gps_data.altitude = pvt_data.altitude;
                gps_data.time.year = pvt_data.datetime.year;
                gps_data.time.month = pvt_data.datetime.month;
                gps_data.time.day = pvt_data.datetime.day;
                gps_data.time.hour = pvt_data.datetime.hour;
                gps_data.time.minute = pvt_data.datetime.minute;
                gps_data.time.second = pvt_data.datetime.seconds;

                k_sem_give(&gps_fix_found);
            }

            if (pvt_data.flags & NRF_MODEM_GNSS_PVT_FLAG_DEADLINE_MISSED) {
                LOG_INF("GNSS blocked by LTE activity");
            }

            if (pvt_data.flags & NRF_MODEM_GNSS_PVT_FLAG_NOT_ENOUGH_WINDOW_TIME) {
                LOG_INF("Insufficient GNSS time windows");
            }
            break;

        case NRF_MODEM_GNSS_EVT_PERIODIC_WAKEUP:
            LOG_INF("GNSS has woken up");
            break;

        case NRF_MODEM_GNSS_EVT_SLEEP_AFTER_FIX:
            LOG_INF("GNSS is going to sleep");
            break;

        default:
            break;
    }
}

int gnss_init_and_start()
{
    int err;

    err = nrf_modem_gnss_event_handler_set(gnss_event_handler);
    if (err != 0) {
		LOG_ERR("Failed to set GNSS event handler, error %d", err);
		return err;
	}

    err = nrf_modem_gnss_fix_interval_set(CONFIG_GNSS_PERIODIC_INTERVAL);
	if (err != 0) {
		LOG_ERR("Failed to set GNSS fix interval, error %d", err);
		return err;
	}

    err = nrf_modem_gnss_fix_retry_set(CONFIG_GNSS_PERIODIC_TIMEOUT);
	if (err != 0) {
		LOG_ERR("Failed to set GNSS fix retry, error %d", err);
		return err;
	}

	LOG_INF("Starting GNSS");

    err = nrf_modem_gnss_start();
	if (err != 0) {
		LOG_ERR("Failed to start GNSS, error %d", err);
		return err;
	}

    err = nrf_modem_gnss_prio_mode_enable();
    if (err != 0) {
        LOG_ERR("Failed to enable GNSS priority mode, error %d", err);
        return err;
    }

    return 0;
}
```

## src/lte_common.c
```c
#include "lte_common.h"
#include "coap_common.h"

#include <zephyr/logging/log.h>
#include <modem/nrf_modem_lib.h>
#include <modem/modem_key_mgmt.h>
#include <dk_buttons_and_leds.h>

LOG_MODULE_REGISTER(Tracker_LTE, LOG_LEVEL_INF);

K_SEM_DEFINE(lte_connected, 0, 1);
K_SEM_DEFINE(neighbors_found, 0, 1);

struct lte_geo_data geo_data = {
    .current_cell = { .mcc = 0, .mnc = 0, .tac = 0, .id = 0, .rsrp = 0 },
    .gci_cells_count = 0
};

void lte_handler(const struct lte_lc_evt *const evt)
{
    switch (evt->type) {
        case LTE_LC_EVT_NW_REG_STATUS:
            if (
                (evt->nw_reg_status != LTE_LC_NW_REG_REGISTERED_HOME) &&
                (evt->nw_reg_status != LTE_LC_NW_REG_REGISTERED_ROAMING)
            ) {
                dk_set_led_off(DK_LED2);
                break;
            }

            k_sem_give(&lte_connected);
            dk_set_led_on(DK_LED2);

            break;

        case LTE_LC_EVT_RRC_UPDATE:
            LOG_INF("RRC mode: %s", evt->rrc_mode == LTE_LC_RRC_MODE_CONNECTED ?
                    "Connected" : "Idle");
            break;

        case LTE_LC_EVT_PSM_UPDATE:
            LOG_INF("PSM parameter updated");
            break;

        case LTE_LC_EVT_EDRX_UPDATE:
            LOG_INF("eDRX parameter updated");
            break;

        case LTE_LC_EVT_NEIGHBOR_CELL_MEAS:
            LOG_INF("Neighbor cell measurement result received, GCIs = %d", evt->cells_info.gci_cells_count);
            
            geo_data.current_cell.mcc = evt->cells_info.current_cell.mcc;
            geo_data.current_cell.mnc = evt->cells_info.current_cell.mnc;
            geo_data.current_cell.id = evt->cells_info.current_cell.id;
            geo_data.current_cell.tac = evt->cells_info.current_cell.tac;
            geo_data.current_cell.rsrp = evt->cells_info.current_cell.rsrp;

            geo_data.gci_cells_count = MIN(evt->cells_info.gci_cells_count, MAX_GCI_CELLS);
            for (uint8_t idx = 0; idx < geo_data.gci_cells_count; ++idx) {
                geo_data.gci_cells[idx].id = evt->cells_info.gci_cells[idx].id;
                geo_data.gci_cells[idx].mcc = evt->cells_info.gci_cells[idx].mcc;
                geo_data.gci_cells[idx].mnc = evt->cells_info.gci_cells[idx].mnc;
                geo_data.gci_cells[idx].tac = evt->cells_info.gci_cells[idx].tac;
                geo_data.gci_cells[idx].rsrp = evt->cells_info.gci_cells[idx].rsrp;
            }

            k_sem_give(&neighbors_found);
            break;

        default:
            break;
    }
}

int modem_configure()
{
    int err;
    
    LOG_INF("Initializing modem library");
    err = nrf_modem_lib_init();
    if (err) {
        LOG_ERR("Failed to initialize the modem library, error %d", err);
        return err;
    }
    LOG_INF("Modem library initialized");

    LOG_INF("Requesting PSM");
    err = lte_lc_psm_req(false);
    if (err) {
        LOG_ERR("Failed to request PSM from modem, error %d", err);
    }

    LOG_INF("Requesting eDRX");
    err = lte_lc_edrx_req(false);
    if (err) {
        LOG_ERR("Failed to request eDRX from modem, error %d", err);
    }

    LOG_INF("Writing PSK identity to the modem");
    err = modem_key_mgmt_write(SEC_TAG, MODEM_KEY_MGMT_CRED_TYPE_IDENTITY,
                                CONFIG_COAP_DEVICE_NAME, strlen(CONFIG_COAP_DEVICE_NAME));
    if (err) {
        LOG_ERR("Failed to write identity: %d\n", err);
	    return err;
    }

    err = modem_key_mgmt_write(SEC_TAG, MODEM_KEY_MGMT_CRED_TYPE_PSK, CONFIG_COAP_SERVER_PSK, 
			strlen(CONFIG_COAP_SERVER_PSK));
    if (err) {
    	LOG_ERR("Failed to write identity: %d\n", err);
    	return err;
    }
    LOG_INF("Identity written");

    LOG_INF("Connecting to LTE network");
    err = lte_lc_connect_async(lte_handler);
    if (err) {
        LOG_ERR("Error when calling lte_lc_connect_async, error %d", err);
        return err;
    }

    err = lte_lc_func_mode_set(LTE_LC_FUNC_MODE_DEACTIVATE_LTE);
    if (err) {
        LOG_ERR("Error when setting LTE mode to, error %d", err);
        return err;
    }

    return 0;
}
```
